## boards/shields/keywellcs4/Kconfig.defconfig
```kconfig
# Copyright (c) 2020 The ZMK Contributors
# SPDX-License-Identifier: MIT

if keywellcs4_left

config ZMK_KEYBOARD_NAME
    default "keywellcs4"

config ZMK_SPLIT_ROLE_CENTRAL
    default y

endif

if SHIELD_KEYWELLCS4_LEFT || SHIELD_KEYWELLCS4_RIGHT

config ZMK_SPLIT
    default y

endif
```

## boards/shields/keywellcs4/Kconfig.shield
```kconfig
# Copyright (c) 2020 The ZMK Contributors
# SPDX-License-Identifier: MIT

config SHIELD_KEYWELLCS4_LEFT
    def_bool $(shields_list_contains,keywellcs4_left)

config SHIELD_KEYWELLCS4_RIGHT
    def_bool $(shields_list_contains,keywellcs4_right)
```

## config/boards/shields/cs4-keywell/Kconfig.defconfig
```kconfig
# Copyright (c) 2020 The ZMK Contributors
# SPDX-License-Identifier: MIT

if SHIELD_keywellcs4_LEFT

config ZMK_KEYBOARD_NAME
    default "keywellcs4"

config ZMK_SPLIT_ROLE_CENTRAL
    default y

endif

if SHIELD_keywellcs4_LEFT || SHIELD_keywellcs4_RIGHT

config ZMK_SPLIT
    default y

endif
```

## config/boards/shields/cs4-keywell/Kconfig.shield
```kconfig
# Copyright (c) 2020 The ZMK Contributors
# SPDX-License-Identifier: MIT

config SHIELD_keywellcs4_LEFT
    def_bool $(shields_list_contains,keywellcs4_left)

config SHIELD_keywellcs4_RIGHT
    def_bool $(shields_list_contains,keywellcs4_right)
```

## config/west.yml
```yaml
manifest:
  defaults:
    remote: urob
  remotes:
    - name: zmkfirmware
      url-base: https://github.com/zmkfirmware
    - name: urob
      url-base: https://github.com/urob
  projects:
    - name: zmk
      remote: zmkfirmware
      revision: 0331b7d16e80954b807917f9323e59ffc1e3b626 # main (4/19/2026)
      import: app/west.yml

    # Required by timeless HRM on main branch
    - name: zmk-helpers
      path: modules/zmk/helpers
      revision: 0b9e9d1dd9e86f70b4c8c2b0fab55c4f90c9d2e3 # main (4/19/2026)

    - name: zmk-unicode
      path: modules/zmk/unicode
      revision: 1a6dbc797a46c4a61c3c71a7a9d013a5d5aee49e # main (4/19/2026)

    # Zephyr modules (pinned subset, avoids pulling everything)
    - name: zephyr
      remote: zmkfirmware
      revision: 58a5874a446ace2893a196848282d271a551e512 # v4.1.0+zmk-fixes
      clone-depth: 1
      import:
        name-allowlist:
          - cmsis
          - hal_nordic
          - hal_rpi_pico
          - hal_stm32
          - mbedtls
          - tinycrypt

  self:
    path: config
```
